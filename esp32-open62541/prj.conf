## CMakeLists.txt
```
cmake_minimum_required(VERSION 3.20.0)

set(BOARD esp32_devkitc/esp32/procpu) # default board 
list(APPEND ZEPHYR_EXTRA_MODULES ../modules/lib/open62541/arch) # Open 62541's zephyr module is not in it's root so we do this hack

find_package(Zephyr REQUIRED HINTS $ENV{ZEPHYR_BASE})
project(esp32-open65241)

# --- Open62541 Configuration ---
zephyr_compile_definitions(zsock_fd_set=zvfs_fd_set) # fix build error with size of fd_set
set(UA_ARCHITECTURE "zephyr")
set(UA_NAMESPACE_ZERO "MINIMAL") # needed to fit on esp32

# 1. Disable PubSub (Huge savings)
set(UA_ENABLE_PUBSUB OFF)

# 2. Disable Encryption (Removes MbedTLS dependency = Huge RAM savings)
set(UA_ENABLE_ENCRYPTION OFF)

# 3. Disable Discovery Multicast (Saves network buffers)
set(UA_ENABLE_DISCOVERY_MULTICAST OFF)
set(UA_ENABLE_DISCOVERY OFF)
# set(UA_ENABLE_SUBSCRIPTIONS OFF CACHE BOOL "" FORCE)

set(UA_ENABLE_SERVER ON)
# set(UA_ENABLE_CLIENT OFF)

target_link_libraries(app PUBLIC open62541)
target_sources(app PRIVATE src/main.c)
```

## prj.conf
```kconfig
# --- Network Essentials ---
CONFIG_NETWORKING=y
CONFIG_NET_L2_WIFI_MGMT=y
CONFIG_WIFI=y
CONFIG_WIFI_ESP32=y

# IPv4 Only (Saves ~10kB vs Dual Stack)
CONFIG_NET_IPV6=n
CONFIG_NET_IPV4=y
CONFIG_NET_TCP=y
CONFIG_NET_UDP=y
CONFIG_NET_SOCKETS=y

# --- Memory Management (The Squeeze) ---
# We reduced static usage (MbedTLS, IPv6, Logs), so we can GROW the Heap.
# Try 90KB. If this fails to link, reduce to 80000.
CONFIG_HEAP_MEM_POOL_SIZE=80000

# Minimal Main Stack
CONFIG_MAIN_STACK_SIZE=4096
CONFIG_ISR_STACK_SIZE=2048

# --- Network Buffers (Minimum viable for TCP) ---
# Too small = dropped packets. Too large = OOM.
# 8 is a safe lower bound for simple OPC UA.
CONFIG_NET_PKT_RX_COUNT=8
CONFIG_NET_BUF_RX_COUNT=8
CONFIG_NET_PKT_TX_COUNT=8
CONFIG_NET_BUF_TX_COUNT=8
CONFIG_NET_MAX_CONTEXTS=5
CONFIG_NET_TCP_MAX_RECV_WINDOW_SIZE=2048

# --- Open62541 & System ---
CONFIG_OPEN62541=y
CONFIG_POSIX_API=y
CONFIG_EVENTFD=y
CONFIG_ZVFS_OPEN_MAX=10
CONFIG_NET_SOCKETS_POLL_MAX=10

# C++ & LibC
CONFIG_CPP=n
CONFIG_STD_CPP11=n
CONFIG_REQUIRES_FULL_LIBC=n
CONFIG_NEWLIB_LIBC=n

# --- Disable Heavy Features ---
# Logging eats RAM for buffers. Disable it for production/testing.
CONFIG_LOG=y
CONFIG_NET_LOG=y

# Disable MbedTLS (We disabled encryption in CMake)
CONFIG_MBEDTLS=y
```

## src/main.c
```c
#include <zephyr/kernel.h>
#include <zephyr/net/wifi_mgmt.h>
#include <zephyr/net/net_if.h>

#include <open62541/server.h>
#include <open62541/server_config_default.h>
#include <open62541/types.h>
#include <open62541/plugin/log_stdout.h>

// Hardcoded for simplicity; in production use a shell or provisioning
#define WIFI_SSID ""
#define WIFI_PSK  ""

static UA_Boolean running = true;

static void connect_wifi(void) {
    struct net_if *iface = net_if_get_default();
    struct wifi_connect_req_params cnx_params = {
        .ssid = WIFI_SSID,
        .ssid_length = strlen(WIFI_SSID),
        .psk = WIFI_PSK,
        .psk_length = strlen(WIFI_PSK),
        .channel = 0,
        .security = WIFI_SECURITY_TYPE_PSK,
    };

    printk("Connecting to Wi-Fi...\n");
    if (net_mgmt(NET_REQUEST_WIFI_CONNECT, iface, &cnx_params, sizeof(cnx_params))) {
        printk("Wi-Fi connection request failed\n");
    } else {
        printk("Wi-Fi connection requested. Waiting for IP...\n");
        // In real code, wait for NET_EVENT_IPV4_ADDR_ADD event here
        k_sleep(K_SECONDS(10)); 
    }
}

static void add_variable(UA_Server *server) {
    /* Define attributes of the variable */
    UA_VariableAttributes attr = UA_VariableAttributes_default;
    UA_Int32 myInteger = 42;
    UA_Variant_setScalar(&attr.value, &myInteger, &UA_TYPES[UA_TYPES_INT32]);
    attr.description = UA_LOCALIZEDTEXT("en-US", "Zephyr Variable");
    attr.displayName = UA_LOCALIZEDTEXT("en-US", "ZephyrVar");
    attr.accessLevel = UA_ACCESSLEVELMASK_READ | UA_ACCESSLEVELMASK_WRITE;

    /* Add the variable node to the information model */
    UA_NodeId myIntegerNodeId = UA_NODEID_STRING(1, "zephyr.var");
    UA_QualifiedName myIntegerName = UA_QUALIFIEDNAME(1, "ZephyrVar");
    UA_NodeId parentNodeId = UA_NODEID_NUMERIC(0, UA_NS0ID_OBJECTSFOLDER);
    UA_NodeId parentReferenceNodeId = UA_NODEID_NUMERIC(0, UA_NS0ID_ORGANIZES);

    UA_Server_addVariableNode(server, myIntegerNodeId, parentNodeId,
                              parentReferenceNodeId, myIntegerName,
                              UA_NODEID_NUMERIC(0, UA_NS0ID_BASEDATAVARIABLETYPE),
                              attr, NULL, NULL);
}

int main(void) {
    k_sleep(K_SECONDS(5)); 
    connect_wifi();

    // Create Server
    UA_Server *server = UA_Server_new();
    UA_ServerConfig *config = UA_Server_getConfig(server);
    
    // Set custom network settings if needed (default usually works with Zephyr sockets)
    UA_ServerConfig_setDefault(config);

    // Add a test variable
    add_variable(server);

    printk("Starting OPC UA Server...\n");

    // Run the server loop. 
    // UA_Server_run uses an internal loop; use run_iterate for non-blocking if needed
    UA_StatusCode retval = UA_Server_run(server, &running);

    UA_Server_delete(server);
    return retval == UA_STATUSCODE_GOOD ? 0 : 1;
}

int access(const char *pathname, int mode) {
    return -1;
}
```
