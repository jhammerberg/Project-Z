## west.yml
```yaml
manifest:
  remotes:
    - name: zephyrproject
      url-base: https://github.com/zephyrproject-rtos
    - name: open62541
      url-base: https://github.com/open62541

  projects:
    # Include the main "zephyr" application
    - name: zephyr
      remote: zephyrproject
      revision: v4.3.0 # note: feel free to change this but using the latest release can have weird issues
      import: true
    - name: open62541
      remote: open62541
      revision: master
      path: modules/lib/open62541

  self:
    # Include all directories as applications
    path: .
```
